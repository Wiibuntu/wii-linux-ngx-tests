## init/Kconfig.rej
```kconfig
--- init/Kconfig
+++ init/Kconfig
@@ -1601,13 +1601,27 @@ config EVENTFD
 
 # syscall, maps, verifier
 config BPF_SYSCALL
-	bool "Enable bpf() system call"
-	select ANON_INODES
-	select BPF
+       bool "Enable bpf() system call"
+       select ANON_INODES
+       select BPF
+        default n
+        help
+         Enable the bpf() system call that allows to manipulate eBPF
+         programs and maps via file descriptors.
+
+config FB_MODEDB
 	default n
+	bool "Configure a preferrable framebuffer mode" if EXPERT
+	depends on FB
 	help
-	  Enable the bpf() system call that allows to manipulate eBPF
-	  programs and maps via file descriptors.
+	  For a specific board there should be a preferrable framebuffer mode, which
+	  which may be not good to allow the users to change.  This can be hardcoded
+	  and will reduce the size of the modedb.  A example mode of 640x480 @ 60Hz
+	  (NTSC) was set here for GAMECUBE_COMMON (GameCube/Wii/vWii), anything else
+	  will require editing/adding the mode manually prior to compiling.
+	  (To add additional modes, edit: drivers/video/modedb.c)
+
+	  If unsure, say N.
 
 config SHMEM
 	bool "Use full shmem filesystem" if EXPERT
```

## kernel/gcov/Kconfig.rej
```kconfig
--- kernel/gcov/Kconfig
+++ kernel/gcov/Kconfig
@@ -37,6 +37,7 @@ config ARCH_HAS_GCOV_PROFILE_ALL
 
 config GCOV_PROFILE_ALL
 	bool "Profile entire Kernel"
+	depends on !COMPILE_TEST
 	depends on GCOV_KERNEL
 	depends on ARCH_HAS_GCOV_PROFILE_ALL
 	default n
```

## lib/Kconfig.debug.rej
```kconfig
--- lib/Kconfig.debug
+++ lib/Kconfig.debug
@@ -145,7 +145,7 @@ config DEBUG_INFO_REDUCED
 
 config DEBUG_INFO_SPLIT
 	bool "Produce split debuginfo in .dwo files"
-	depends on DEBUG_INFO
+	depends on DEBUG_INFO && !FRV
 	help
 	  Generate debug info into separate .dwo files. This significantly
 	  reduces the build directory size for builds with DEBUG_INFO,
@@ -197,7 +197,7 @@ config ENABLE_MUST_CHECK
 config FRAME_WARN
 	int "Warn for stack frames larger than (needs gcc 4.4)"
 	range 0 8192
-	default 0 if KASAN
+	default 2048 if GCC_PLUGIN_LATENT_ENTROPY
 	default 1024 if !64BIT
 	default 2048 if 64BIT
 	help
@@ -521,7 +521,7 @@ config DEBUG_KMEMLEAK_EARLY_LOG_SIZE
 	int "Maximum kmemleak early log entries"
 	depends on DEBUG_KMEMLEAK
 	range 200 40000
-	default 400
+	default 16000
 	help
 	  Kmemleak must track all the memory allocations to avoid
 	  reporting false positives. Since memory may be allocated or
@@ -1706,6 +1706,16 @@ config TEST_RHASHTABLE
 
 	  If unsure, say N.
 
+config TEST_HASH
+	tristate "Perform selftest on hash functions"
+	default n
+	help
+	  Enable this option to test the kernel's siphash (<linux/siphash.h>)
+	  hash functions on boot (or module load).
+
+	  This is intended to help people writing architecture-specific
+	  optimized versions.  If unsure, say N.
+
 endmenu # runtime tests
 
 config PROVIDE_OHCI1394_DMA_INIT
@@ -1853,3 +1863,4 @@ source "samples/Kconfig"
 
 source "lib/Kconfig.kgdb"
 
+source "lib/Kconfig.ubsan"
```
